## s3_daplink_usb/sdkconfig.defaults
```kconfig
# Target: ESP32-S3
CONFIG_IDF_TARGET="esp32s3"

# Enable TinyUSB Vendor class
CONFIG_TINYUSB_VENDOR_COUNT=1

# Custom VID/PID (DAPLink)
CONFIG_TINYUSB_DESC_USE_ESPRESSIF_VID=n
CONFIG_TINYUSB_DESC_USE_DEFAULT_PID=n
CONFIG_TINYUSB_DESC_CUSTOM_VID=0x0D28
CONFIG_TINYUSB_DESC_CUSTOM_PID=0x0204
```

## sdkconfig.defaults
```kconfig
# Target: ESP32-S3
CONFIG_IDF_TARGET="esp32s3"

# Enable TinyUSB Vendor class
CONFIG_TINYUSB_VENDOR_COUNT=1

# Custom VID/PID (DAPLink)
CONFIG_TINYUSB_DESC_USE_ESPRESSIF_VID=n
CONFIG_TINYUSB_DESC_USE_DEFAULT_PID=n
CONFIG_TINYUSB_DESC_CUSTOM_VID=0x0D28
CONFIG_TINYUSB_DESC_CUSTOM_PID=0x0204

# Task Watchdog
CONFIG_ESP_TASK_WDT_CHECK_IDLE_TASK_CPU0=y
CONFIG_ESP_TASK_WDT_CHECK_IDLE_TASK_CPU1=n
```
